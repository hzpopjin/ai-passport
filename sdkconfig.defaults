## sdkconfig.defaults
```kconfig
# --- 目标芯片 ---
CONFIG_IDF_TARGET="esp32c3"
# 注:ESP32-C3 无 PSRAM,故不设 CONFIG_SPIRAM。

# --- Flash ---
# FoloToy AI Passport 当前产品/固件基线使用 8MB Flash。
CONFIG_ESPTOOLPY_FLASHSIZE_8MB=y
# 固定 8MB 镜像头，关闭 detect，便于 idf.py merge-bin。
CONFIG_ESPTOOLPY_HEADER_FLASHSIZE_UPDATE=n
# 默认模板只保留 NVS、PHY data 和占用剩余空间的 factory app；用户可按需修改。
CONFIG_PARTITION_TABLE_CUSTOM=y
CONFIG_PARTITION_TABLE_CUSTOM_FILENAME="partitions.csv"
CONFIG_PARTITION_TABLE_FILENAME="partitions.csv"

# --- 控制台:USB-Serial-JTAG(C3 原生 USB,GPIO18/19)---
# 不用 UART0:其默认 TX=GPIO21 与本板背光引脚冲突。
CONFIG_ESP_CONSOLE_USB_SERIAL_JTAG=y
CONFIG_ESP_CONSOLE_SECONDARY_NONE=y

# --- LVGL ---
CONFIG_LV_COLOR_DEPTH_16=y
# 20 ms display refresh period targets up to 50 FPS when rendering and SPI
# transfer complete within the same budget.
CONFIG_LV_DEF_REFR_PERIOD=20
CONFIG_LV_FONT_MONTSERRAT_14=y
CONFIG_LV_FONT_MONTSERRAT_20=y
# LVGL 内置 malloc 池大小(KB)。它是独立静态区、不与系统堆共享,配大了会白白占用 RAM。
# H2H uses 48 KB for its own pages and image transformations.

# --- 系统 ---
CONFIG_FREERTOS_HZ=1000

# --- H2H Pocket: bounded memory; account network is opt-in ---
CONFIG_BT_ENABLED=y
CONFIG_BT_NIMBLE_ENABLED=y
CONFIG_BT_NIMBLE_ROLE_CENTRAL=n
CONFIG_BT_NIMBLE_ROLE_PERIPHERAL=y
CONFIG_BT_NIMBLE_ROLE_BROADCASTER=y
CONFIG_BT_NIMBLE_ROLE_OBSERVER=n
CONFIG_BT_NIMBLE_MAX_CONNECTIONS=1
CONFIG_BT_NIMBLE_NVS_PERSIST=n
CONFIG_MBEDTLS_CERTIFICATE_BUNDLE=y
CONFIG_LV_USE_QRCODE=y
CONFIG_LV_MEM_SIZE_KILOBYTES=48
CONFIG_LV_TXT_ENC_UTF8=y
CONFIG_LV_USE_FONT_PLACEHOLDER=y
CONFIG_COMPILER_OPTIMIZATION_PERF=y
CONFIG_ESP_DEFAULT_CPU_FREQ_MHZ_160=y
CONFIG_AUDIO_DECODER_AAC_SUPPORT=n
CONFIG_AUDIO_DECODER_MP3_SUPPORT=n
CONFIG_AUDIO_DECODER_G711_SUPPORT=n
CONFIG_AUDIO_DECODER_AMRNB_SUPPORT=n
CONFIG_AUDIO_DECODER_AMRWB_SUPPORT=n
CONFIG_AUDIO_DECODER_FLAC_SUPPORT=n
CONFIG_AUDIO_DECODER_OPUS_SUPPORT=y
CONFIG_AUDIO_DECODER_VORBIS_SUPPORT=n
CONFIG_AUDIO_DECODER_ADPCM_SUPPORT=n
CONFIG_AUDIO_DECODER_ALAC_SUPPORT=n
CONFIG_AUDIO_DECODER_PCM_SUPPORT=n
CONFIG_AUDIO_DECODER_SBC_SUPPORT=n
CONFIG_AUDIO_DECODER_LC3_SUPPORT=n
CONFIG_AUDIO_DECODER_G722_SUPPORT=n
CONFIG_AUDIO_SIMPLE_DEC_WAV_SUPPORT=n
CONFIG_AUDIO_SIMPLE_DEC_M4A_SUPPORT=n
CONFIG_AUDIO_SIMPLE_DEC_TS_SUPPORT=n
CONFIG_AUDIO_SIMPLE_DEC_OGG_SUPPORT=y
CONFIG_AUDIO_ENCODER_AAC_SUPPORT=n
CONFIG_AUDIO_ENCODER_G711_SUPPORT=n
CONFIG_AUDIO_ENCODER_AMRNB_SUPPORT=n
CONFIG_AUDIO_ENCODER_AMRWB_SUPPORT=n
CONFIG_AUDIO_ENCODER_OPUS_SUPPORT=n
CONFIG_AUDIO_ENCODER_ADPCM_SUPPORT=n
CONFIG_AUDIO_ENCODER_ALAC_SUPPORT=n
CONFIG_AUDIO_ENCODER_PCM_SUPPORT=n
CONFIG_AUDIO_ENCODER_SBC_SUPPORT=n
CONFIG_AUDIO_ENCODER_LC3_SUPPORT=n
CONFIG_AUDIO_ENCODER_G722_SUPPORT=n
```

## tools/pocket-enrollment/device/sdkconfig.defaults
```kconfig
CONFIG_IDF_TARGET="esp32c3"
CONFIG_ESPTOOLPY_FLASHSIZE_8MB=y
CONFIG_ESPTOOLPY_FLASHMODE_DIO=y
CONFIG_ESPTOOLPY_FLASHFREQ_80M=y
CONFIG_PARTITION_TABLE_CUSTOM=y
CONFIG_PARTITION_TABLE_CUSTOM_FILENAME="partitions.csv"
CONFIG_PARTITION_TABLE_OFFSET=0x8000
CONFIG_ESP_CONSOLE_NONE=y
CONFIG_ESP_CONSOLE_SECONDARY_NONE=y
CONFIG_LOG_DEFAULT_LEVEL_NONE=y
CONFIG_BOOTLOADER_LOG_LEVEL_NONE=y
CONFIG_ESP_MAIN_TASK_STACK_SIZE=8192
CONFIG_ADC_BUTTON_SAMPLE_TIMES=4
```
